## Integrations/Zigbee/BTN-1_IDF/sdkconfig.defaults
```kconfig
# Partition Table
CONFIG_PARTITION_TABLE_CUSTOM=y
CONFIG_PARTITION_TABLE_CUSTOM_FILENAME="partitions.csv"

# Zigbee
CONFIG_ZB_ENABLED=y
CONFIG_ZB_ZCZR=y
CONFIG_ZB_RADIO_NATIVE=y

# IEEE 802.15.4
CONFIG_IEEE802154_ENABLED=y

# Logging
CONFIG_LOG_DEFAULT_LEVEL_INFO=y
```

## Integrations/Zigbee/BTN-1_Zig/sdkconfig.defaults
```kconfig
# Partition Table
CONFIG_PARTITION_TABLE_CUSTOM=y
CONFIG_PARTITION_TABLE_CUSTOM_FILENAME="partitions.csv"
CONFIG_PARTITION_TABLE_FILENAME="partitions.csv"

# Serial flasher config
CONFIG_ESPTOOLPY_FLASHSIZE_8MB=y
CONFIG_ESPTOOLPY_FLASHSIZE="8MB"

# Zigbee Configuration
CONFIG_ZB_ENABLED=y
CONFIG_ZB_ED_ROLE=y

# Enable Zigbee stack and IEEE 802.15.4
CONFIG_IEEE802154_ENABLED=y

# Enable OpenThread (required for Zigbee on ESP32-C6)
CONFIG_OPENTHREAD_ENABLED=y
CONFIG_OPENTHREAD_RADIO=y

# FreeRTOS
CONFIG_FREERTOS_HZ=1000

# ESP System Settings
CONFIG_ESP_TASK_WDT_TIMEOUT_S=10

# Console output
CONFIG_ESP_CONSOLE_USB_SERIAL_JTAG=y

# Compiler optimization
CONFIG_COMPILER_OPTIMIZATION_SIZE=y
CONFIG_COMPILER_OPTIMIZATION_ASSERTIONS_ENABLE=y

# Disable deprecation warnings as errors
CONFIG_COMPILER_WARN_DEPRECATED=n

# NVS
CONFIG_NVS_ENCRYPTION=n

# Power Management
CONFIG_PM_ENABLE=y
CONFIG_PM_DFS_INIT_AUTO=y

# ESP Sleep
CONFIG_ESP_SLEEP_POWER_DOWN_FLASH=y

# ADC
CONFIG_ADC_ONESHOT_CTRL_FUNC_IN_IRAM=n
```
